## arch/arm/mach-airoha/Kconfig
```kconfig
if ARCH_AIROHA

config SYS_SOC
	default "airoha"

config SYS_VENDOR
	default "airoha"

choice
	prompt "Airoha board select"

config TARGET_AN7581
	bool "Airoha AN7581 SoC"
	select ARM64
	help
	  The Airoha EN7581 is a ARM-based SoC with a quad-core Cortex-A7
	  including NEON and GPU, Mali-450 graphics, several DDR3 options,
	  crypto engine, built-in Wi-Fi / Bluetooth combo chip, JPEG decoder,
	  video interfaces supporting HDMI and MIPI, and video codec support.
	  Peripherals include Gigabit Ethernet, switch, USB3.0 and OTG, PCIe,
	  I2S, PCM, S/PDIF, UART, SPI, I2C, IR TX/RX, and PWM.

endchoice

config SYS_BOARD
	string "Board name"
	default "an7581" if TARGET_AN7581
	default ""
	help
	  This option contains information about board name.
	  Based on this option board/<CONFIG_SYS_VENDOR>/<CONFIG_SYS_BOARD> will
	  be used.

config SYS_CONFIG_NAME
	string "Board configuration name"
	default "an7581" if TARGET_AN7581
	default ""
	help
	  This option contains information about board configuration name.
	  Based on this option include/configs/<CONFIG_SYS_CONFIG_NAME>.h header
	  will be used for board configuration.

endif
```
